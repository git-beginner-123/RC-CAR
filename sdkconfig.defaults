## sdkconfig.defaults
```kconfig
CONFIG_IDF_TARGET="esp32s3"
CONFIG_IDF_TARGET_ESP32S3=y
CONFIG_CAMERA_OV2640=y
CONFIG_CAMERA_OV2640_AUTO_DETECT_DVP_INTERFACE_SENSOR=y
CONFIG_CAMERA_OV2640_DVP_JPEG_640X480_25FPS=y
CONFIG_ESP_WIFI_ENABLE_WPA3_SAE=n
CONFIG_ESP_WIFI_ENABLE_SAE_PK=n
CONFIG_ESP_WIFI_ENABLE_SAE_H2E=n
CONFIG_ESP_WIFI_SOFTAP_SAE_SUPPORT=n
CONFIG_ESP_WIFI_ENABLE_WPA3_OWE_STA=n
CONFIG_ESP_WIFI_ENTERPRISE_SUPPORT=n
CONFIG_LWIP_IPV6=n
CONFIG_CAM_CTRL_SPI_ENABLE=n
CONFIG_LWIP_MAX_SOCKETS=8
CONFIG_LWIP_MAX_ACTIVE_TCP=4
CONFIG_LWIP_MAX_LISTENING_TCP=4
CONFIG_HTTPD_MAX_URI_LEN=128
CONFIG_HTTPD_MAX_REQ_HDR_LEN=512
```
